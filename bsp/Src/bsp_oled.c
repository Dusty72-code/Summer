//
// Created by Dolores on 2026/8/9.
//
#include "bsp_oled.h"
#include "i2c.h"

static uint8_t oled_buf[OLED_WIDTH * OLED_PAGES];
static uint8_t g_oled_i2c_err_cnt = 0U;

static HAL_StatusTypeDef oled_i2c_safe_write(uint8_t *pdata, uint16_t size) {
    HAL_StatusTypeDef status = HAL_I2C_Master_Transmit(
        &OLED_I2C_HANDLE, OLED_I2C_ADDR, pdata, size, 20);
    if (status != HAL_OK) {
        g_oled_i2c_err_cnt++;
        if (g_oled_i2c_err_cnt > 5U) {
            HAL_I2C_DeInit(&OLED_I2C_HANDLE);
            MX_I2C1_Init();
            g_oled_i2c_err_cnt = 0U;
        }
    } else {
        g_oled_i2c_err_cnt = 0U;
    }
    return status;
}

static void oled_write_cmd(uint8_t cmd) {
    uint8_t data[2] = { 0x00, cmd };
    oled_i2c_safe_write(data, 2);
}

static void oled_write_data(uint8_t val) {
    uint8_t data[2] = { 0x40, val };
    oled_i2c_safe_write(data, 2);
}

void BSP_OLED_Init(void) {
    oled_write_cmd(0xAE);
    oled_write_cmd(0x00); oled_write_cmd(0x10);
    oled_write_cmd(0x40);
    oled_write_cmd(0x81); oled_write_cmd(0xCF);
    oled_write_cmd(0xA1);
    oled_write_cmd(0xC8);
    oled_write_cmd(0xA6);
    oled_write_cmd(0xA8); oled_write_cmd(0x3F);
    oled_write_cmd(0xD3); oled_write_cmd(0x00);
    oled_write_cmd(0xD5); oled_write_cmd(0x80);
    oled_write_cmd(0xD9); oled_write_cmd(0xF1);
    oled_write_cmd(0xDA); oled_write_cmd(0x12);
    oled_write_cmd(0xDB); oled_write_cmd(0x40);
    oled_write_cmd(0x8D); oled_write_cmd(0x14);
    oled_write_cmd(0xAF);
    BSP_OLED_Clear();
    BSP_OLED_Refresh();
}

void BSP_OLED_Clear(void) {
    memset(oled_buf, 0x00, sizeof(oled_buf));
}

void BSP_OLED_Refresh(void) {
    for (uint8_t page = 0; page < OLED_PAGES; page++) {
        oled_write_cmd(0xB0 + page);
        oled_write_cmd(0x00);
        oled_write_cmd(0x10);
        for (uint8_t col = 0; col < OLED_WIDTH; col++) {
            oled_write_data(oled_buf[page * OLED_WIDTH + col]);
        }
    }
}

/* 6x8 ASCII 字库 */
static const uint8_t font6x8[][6] = {
    {0x00,0x00,0x00,0x00,0x00,0x00}, {0x00,0x00,0x5F,0x00,0x00,0x00},
    {0x00,0x07,0x00,0x07,0x00,0x00}, {0x14,0x7F,0x14,0x7F,0x14,0x00},
    {0x24,0x2A,0x7F,0x2A,0x12,0x00}, {0x23,0x13,0x08,0x64,0x62,0x00},
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    {0x08,0x04,0x08,0x10,0x08,0x00},  // ~
};

void BSP_OLED_ShowChar(uint8_t x, uint8_t y, char ch) {
    if (ch < 0x20 || ch > 0x7E) ch = ' ';
    if (x > OLED_WIDTH - 6 || y > OLED_HEIGHT - 8) return;
    uint8_t idx = ch - 0x20;
    uint8_t page = y / 8U;
    uint8_t bit = y % 8U;
    for (uint8_t i = 0; i < 6; i++) {
        uint8_t col = x + i;
        if (col >= OLED_WIDTH) break;
        if (bit == 0) {
            oled_buf[page * OLED_WIDTH + col] = font6x8[idx][i];
        } else {
            oled_buf[page * OLED_WIDTH + col] &= ~(0xFFU << bit);
            oled_buf[page * OLED_WIDTH + col] |= (font6x8[idx][i] << bit);
            if (page + 1 < OLED_PAGES) {
                oled_buf[(page + 1) * OLED_WIDTH + col] &= ~(0xFFU >> (8U - bit));
                oled_buf[(page + 1) * OLED_WIDTH + col] |= (font6x8[idx][i] >> (8U - bit));
            }
        }
    }
}

void BSP_OLED_ShowString(uint8_t x, uint8_t y, const char *str) {
    while (*str) {
        BSP_OLED_ShowChar(x, y, *str);
        x += 6;
        if (x > OLED_WIDTH - 6) { x = 0; y += 8; }
        str++;
    }
}
